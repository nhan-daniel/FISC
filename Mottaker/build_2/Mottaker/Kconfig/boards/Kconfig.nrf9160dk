## Mottaker/build_2/Mottaker/Kconfig/boards/Kconfig.nrf9160dk
```kconfig
# Load board Kconfig descriptions.
osource "/opt/nordic/ncs/v2.9.0/zephyr/boards/nordic/nrf9160dk/Kconfig.nrf9160dk"
```

## gnss/build/signal_sender/Kconfig/arch/Kconfig
```kconfig
# Load Zephyr Arch Kconfig descriptions.
osource "/home/kim/ncs/v2.9.1/zephyr/arch/x86/Kconfig"
osource "/home/kim/ncs/v2.9.1/zephyr/arch/xtensa/Kconfig"
osource "/home/kim/ncs/v2.9.1/zephyr/arch/sparc/Kconfig"
osource "/home/kim/ncs/v2.9.1/zephyr/arch/riscv/Kconfig"
osource "/home/kim/ncs/v2.9.1/zephyr/arch/posix/Kconfig"
osource "/home/kim/ncs/v2.9.1/zephyr/arch/nios2/Kconfig"
osource "/home/kim/ncs/v2.9.1/zephyr/arch/mips/Kconfig"
osource "/home/kim/ncs/v2.9.1/zephyr/arch/arm64/Kconfig"
osource "/home/kim/ncs/v2.9.1/zephyr/arch/arm/Kconfig"
osource "/home/kim/ncs/v2.9.1/zephyr/arch/arc/Kconfig"
```

## gnss/build/signal_sender/Kconfig/boards/Kconfig
```kconfig
# Load Zephyr board Kconfig descriptions.
osource "/home/kim/ncs/v2.9.1/zephyr/boards/nordic/nrf9160dk/Kconfig"
```

## gnss/build/signal_sender/Kconfig/boards/Kconfig.nrf9160dk
```kconfig
# Load board Kconfig descriptions.
osource "/home/kim/ncs/v2.9.1/zephyr/boards/nordic/nrf9160dk/Kconfig.nrf9160dk"
```
