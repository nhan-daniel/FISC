## prj.conf
```kconfig
#
# Copyright (c) 2020 Nordic Semiconductor ASA
#
# SPDX-License-Identifier: LicenseRef-Nordic-5-Clause
#

# Logging
CONFIG_LOG=y

# Button and LED support
CONFIG_DK_LIBRARY=y

# Newlib
CONFIG_NEWLIB_LIBC=y

# Networking
CONFIG_NETWORKING=y
CONFIG_NET_NATIVE=n
CONFIG_NET_SOCKETS_OFFLOAD=y
CONFIG_NET_SOCKETS=y
CONFIG_POSIX_API=y

# Memory
CONFIG_MAIN_STACK_SIZE=4096
CONFIG_HEAP_MEM_POOL_SIZE=2048

# Modem library
CONFIG_NRF_MODEM_LIB=y

# LTE link control
CONFIG_LTE_LINK_CONTROL=y
CONFIG_LTE_NETWORK_MODE_LTE_M_NBIOT=y

# MQTT
# STEP 2.1 - Enable and configure the MQTT library
CONFIG_MQTT_LIB=y
CONFIG_MQTT_CLEAN_SESSION=y

# Application
# STEP 2.2 - Configure the broker name, TCP port, topic names, and message
CONFIG_MQTT_PUB_TOPIC="gruppe10/elsysprosjekt/hovedtopic"
CONFIG_MQTT_SUB_TOPIC="gruppe10/elsysprosjekt/hovedtopic"
CONFIG_BUTTON_EVENT_PUBLISH_MSG="LED1ON"
CONFIG_MQTT_BROKER_HOSTNAME="test.mosquitto.org"
CONFIG_MQTT_BROKER_PORT=1883

CONFIG_NEWLIB_LIBC_FLOAT_PRINTF=y
CONFIG_NEWLIB_LIBC_FLOAT_SCANF=y
```

## src/main.c
```c
/*
 * Copyright (c) 2018 Nordic Semiconductor ASA
 *
 * SPDX-License-Identifier: LicenseRef-Nordic-5-Clause
 */

/*Koden har tatt utgangspunkt fra Lesson 4, oppgave 1 i Cellular IoT Fundamentals i DevAcademy*/

#include <stdio.h>
#include <ncs_version.h>
#include <zephyr/kernel.h>
#include <zephyr/net/socket.h>
#include <zephyr/logging/log.h>
#include <dk_buttons_and_leds.h>
#include <modem/nrf_modem_lib.h>
#include <modem/lte_lc.h>
#include <zephyr/drivers/gpio.h>
#include <zephyr/sys/printk.h>
#include <zephyr/devicetree.h>
#include <math.h>
#include <zephyr/net/mqtt.h>
#include "mqtt_connection.h"

//GPIO-nummer for utgangene som skal brukes
#define INPUT_PIN 15
#define INPUT_PIN2 16

//Henter GPIO-enheten (gpio0)
#define INPUT_NODE DT_NODELABEL(gpio0)

//Henter LED-definisjoner fra device tree
#define LED0_NODE DT_ALIAS(led0)
#define LED2_NODE DT_ALIAS(led2)

//Referanser til GPIO og LEDs
const struct device *gpio_dev = DEVICE_DT_GET(INPUT_NODE);
static const struct gpio_dt_spec led0 = GPIO_DT_SPEC_GET(LED0_NODE, gpios);
static const struct gpio_dt_spec led2 = GPIO_DT_SPEC_GET(LED2_NODE, gpios);

//Tre forskjellige timere for å blinking og lyd
static struct k_timer blink_timer_lys;
static struct k_timer blink_timer_alarm;
static struct k_timer blink_timer_diode;

//Timer-handler for LED3
static void blink_timer_handler_lys(struct k_timer *timer)
{
    gpio_pin_toggle_dt(&led2);
}
//Timer-handler for GPIO-pin 15
static void blink_timer_handler_alarm(struct k_timer *timer)
{
	gpio_pin_toggle(gpio_dev, INPUT_PIN);

}
//Timer-handler for GPIO-pin 16
static void blink_timer_handler_diode(struct k_timer *timer)
{
	gpio_pin_toggle(gpio_dev, INPUT_PIN2);

}

//Funksjon som sjekker om alarm er aktivert
static bool blinking = false;
static void check_alarm(){

	int input_state = gpio_pin_get_dt(&led0);
	
	printk("Input state: %d\n", input_state);

    if (input_state == 1 && !blinking) {
        blinking = true;

		//Starter GPIO-pin 15 og 16 høye
		int ret = gpio_pin_set(gpio_dev, INPUT_PIN, 1);
		if (ret < 0) {
			printk("Failed to set pin %d high (ret = %d)\n", INPUT_PIN, ret);
		}
		int ret2 = gpio_pin_set(gpio_dev, INPUT_PIN2, 1);
		if (ret2 < 0) {
			printk("Failed to set pin %d high (ret = %d)\n", INPUT_PIN2, ret2);
		}

		//Starter alarm, lyd og lys
        k_timer_start(&blink_timer_alarm, K_USEC(500), K_USEC(500));
		k_timer_start(&blink_timer_lys, K_MSEC(300), K_MSEC(300));
		k_timer_start(&blink_timer_diode, K_MSEC(300), K_MSEC(300));

        printk("Input is HIGH: starting LED blink\n");
    } else if (input_state == 0 && blinking) {
        blinking = false;

		//Setter GPIO-pin 15, 16 og LED3 lave
		gpio_pin_set(gpio_dev, INPUT_PIN, 0);
		gpio_pin_set(gpio_dev, INPUT_PIN2, 0);
		gpio_pin_set_dt(&led2, 0);

		//Sjekker for feil
		int ret = gpio_pin_set(gpio_dev, INPUT_PIN, 0);
		if (ret > 0) {
			printk("Failed to set pin %d low (ret = %d)\n", INPUT_PIN, ret);
		}

		int ret2 = gpio_pin_set(gpio_dev, INPUT_PIN2, 0);
		if (ret2 > 0) {
			printk("Failed to set pin %d low (ret = %d)\n", INPUT_PIN2, ret2);
		}

		//Stopper timere
        k_timer_stop(&blink_timer_lys);
		k_timer_stop(&blink_timer_alarm);
		k_timer_stop(&blink_timer_diode);
        printk("Input is LOW: stopping LED blink\n");
    }
}


//MQTT-klient og poll-struktur
static struct mqtt_client client;
static struct pollfd fds;

//Semaphore som venter på at LTE er tilkoblet
static K_SEM_DEFINE(lte_connected, 0, 1);

//Aktiverer logging
LOG_MODULE_REGISTER(Lesson4_Exercise1, LOG_LEVEL_INF);

//Håndterer LTE-hendelser (f.eks. tilkobling)
static void lte_handler(const struct lte_lc_evt *const evt)
{
     switch (evt->type) {
     case LTE_LC_EVT_NW_REG_STATUS:
        if ((evt->nw_reg_status != LTE_LC_NW_REG_REGISTERED_HOME) &&
            (evt->nw_reg_status != LTE_LC_NW_REG_REGISTERED_ROAMING)) {
            break;
        }
		LOG_INF("Network registration status: %s",
				evt->nw_reg_status == LTE_LC_NW_REG_REGISTERED_HOME ?
				"Connected - home network" : "Connected - roaming");
		k_sem_give(&lte_connected);
        break;
	case LTE_LC_EVT_RRC_UPDATE:
		LOG_INF("RRC mode: %s", evt->rrc_mode == LTE_LC_RRC_MODE_CONNECTED ?
				"Connected" : "Idle");
		break;
     default:
             break;
     }
}

//Initierer modem og LTE-tilkobling
static int modem_configure(void)
{
	int err;

	LOG_INF("Initializing modem library");
	err = nrf_modem_lib_init();
	if (err) {
		LOG_ERR("Failed to initialize the modem library, error: %d", err);
		return err;
	}
	
	LOG_INF("Connecting to LTE network");
	err = lte_lc_connect_async(lte_handler);
	if (err) {
		LOG_ERR("Error in lte_lc_connect_async, error: %d", err);
		return err;
	}
	
	//Venter på tilkobling
	k_sem_take(&lte_connected, K_FOREVER);
	LOG_INF("Connected to LTE network");
	//Slår på LED2 som indikerer tilkobling
	dk_set_led_on(DK_LED2); 

	return 0;
}


//Knappetrykk: for å testing
static void button_handler(uint32_t button_state, uint32_t has_changed)
{
	//Knapp som starter alarmen
    if (has_changed & DK_BTN1_MSK) {
        if (button_state & DK_BTN1_MSK) {    
            int err = data_publish(&client, MQTT_QOS_1_AT_LEAST_ONCE,
                                   "LED1ON", sizeof("LED1ON") - 1); 
            if (err) {
                LOG_INF("Failed to send message, %d", err);
                return;  
            }
        }
    }

	//Knapp som stopper og restarter alarmen
    if (has_changed & DK_BTN2_MSK) {
        if (button_state & DK_BTN2_MSK) {    
            int err = data_publish(&client, MQTT_QOS_1_AT_LEAST_ONCE,
                                   "LED1OFF", sizeof("LED1OFF") - 1); 
            if (err) {
                LOG_INF("Failed to send message, %d", err);
                return;  
            }
        }
    }
}





int main(void)
{
	int err;
	uint32_t connect_attempt = 0;

	// Initialiserer LED, modem, knapper
	if (dk_leds_init() != 0) {
		LOG_ERR("Failed to initialize the LED library");
	}
	err = modem_configure();
	if (err) {
		LOG_ERR("Failed to configure the modem");
		return 0;
	}
	if (dk_buttons_init(button_handler) != 0) {
		LOG_ERR("Failed to initialize the buttons library");
	}
	if (!device_is_ready(gpio_dev)) {
		printk("gpio0 device not ready\n");
		return 0;
	}

	//Initialiserer MQTT
	err = client_init(&client);
	if (err) {
		LOG_ERR("Failed to initialize MQTT client: %d", err);
		return 0;
	}

	//Konfigurer GPIO som utganger
	gpio_pin_configure(gpio_dev, INPUT_PIN, GPIO_OUTPUT_INACTIVE);	
	gpio_pin_configure(gpio_dev, INPUT_PIN2, GPIO_OUTPUT_INACTIVE);

//Forsøker å koble til MQTT-server
do_connect:
	//Forsinkelse ved reconnecting
	if (connect_attempt++ > 0) {
		LOG_INF("Reconnecting in %d seconds...",
			CONFIG_MQTT_RECONNECT_DELAY_S);
		k_sleep(K_SECONDS(CONFIG_MQTT_RECONNECT_DELAY_S));
	}

	err = mqtt_connect(&client);
	if (err) {
		LOG_ERR("Error in mqtt_connect: %d", err);
		goto do_connect;
	}

	err = fds_init(&client,&fds);
	if (err) {
		LOG_ERR("Error in fds_init: %d", err);
		return 0;
	}

	//Konfigurer LED1
	gpio_pin_configure_dt(&led0, GPIO_OUTPUT | GPIO_INPUT);

	//Initialiserer timere
	k_timer_init(&blink_timer_alarm, blink_timer_handler_alarm, NULL);
	k_timer_init(&blink_timer_lys, blink_timer_handler_lys, NULL);
	k_timer_init(&blink_timer_diode, blink_timer_handler_diode, NULL);

	//Hovedløkke
	while (1) {
		err = poll(&fds, 1, 5000);
		if (err < 0) {
			LOG_ERR("Error in poll(): %d", errno);
			break;
		}

		//Oppdater MQTT-klient
		err = mqtt_live(&client);
		if ((err != 0) && (err != -EAGAIN)) {
			LOG_ERR("Error in mqtt_live: %d", err);
			break;
		}

		if ((fds.revents & POLLIN) == POLLIN) {
			err = mqtt_input(&client);
			if (err != 0) {
				LOG_ERR("Error in mqtt_input: %d", err);
				break;
			}
		}

		if ((fds.revents & POLLERR) == POLLERR) {
			LOG_ERR("POLLERR");
			break;
		}

		if ((fds.revents & POLLNVAL) == POLLNVAL) {
			LOG_ERR("POLLNVAL");
			break;
		}
		//Sjekk om alarmen skal utløses
		check_alarm();
	}

	//Koble fra MQTT hvis løkka avsluttes
	LOG_INF("Disconnecting MQTT client");
	err = mqtt_disconnect(&client);
	if (err) {
		LOG_ERR("Could not disconnect MQTT client: %d", err);
	}

	//Prøver å koble til på nytt
	goto do_connect;


	return 0;
}
```

## src/mqtt_connection.c
```c
#include <stdio.h>
#include <string.h>
#include <ncs_version.h>

#include <zephyr/logging/log.h>
#include <zephyr/kernel.h>
#include <zephyr/net/socket.h>
#include <zephyr/net/mqtt.h>
#include <nrf_modem_at.h>

#include <dk_buttons_and_leds.h>
#include "mqtt_connection.h"

#include <zephyr/random/random.h>


/* Buffers for MQTT client. */
static uint8_t rx_buffer[CONFIG_MQTT_MESSAGE_BUFFER_SIZE];
static uint8_t tx_buffer[CONFIG_MQTT_MESSAGE_BUFFER_SIZE];
static uint8_t payload_buf[CONFIG_MQTT_PAYLOAD_BUFFER_SIZE];

/* MQTT Broker details. */
static struct sockaddr_storage broker;

LOG_MODULE_DECLARE(Lesson4_Exercise1);

/**@brief Function to get the payload of recived data.
 */
static int get_received_payload(struct mqtt_client *c, size_t length)
{
	int ret;
	int err = 0;

	/* Return an error if the payload is larger than the payload buffer.
	 * Note: To allow new messages, we have to read the payload before returning.
	 */
	if (length > sizeof(payload_buf)) {
		err = -EMSGSIZE;
	}

	/* Truncate payload until it fits in the payload buffer. */
	while (length > sizeof(payload_buf)) {
		ret = mqtt_read_publish_payload_blocking(
				c, payload_buf, (length - sizeof(payload_buf)));
		if (ret == 0) {
			return -EIO;
		} else if (ret < 0) {
			return ret;
		}

		length -= ret;
	}

	ret = mqtt_readall_publish_payload(c, payload_buf, length);
	if (ret) {
		return ret;
	}

	return err;
}

/**@brief Function to subscribe to the configured topic
 */
/* STEP 4 - Define the function subscribe() to subscribe to a specific topic.  */
static int subscribe(struct mqtt_client *const c)
{
	struct mqtt_topic subscribe_topic = {
		.topic = {
			.utf8 = CONFIG_MQTT_SUB_TOPIC,
			.size = strlen(CONFIG_MQTT_SUB_TOPIC)
		},
		.qos = MQTT_QOS_1_AT_LEAST_ONCE
	};

	const struct mqtt_subscription_list subscription_list = {
		.list = &subscribe_topic,
		.list_count = 1,
		.message_id = 1234
	};

	LOG_INF("Subscribing to: %s len %u", CONFIG_MQTT_SUB_TOPIC,
		(unsigned int)strlen(CONFIG_MQTT_SUB_TOPIC));

	return mqtt_subscribe(c, &subscription_list);
}

/**@brief Function to print strings without null-termination
 */
static void data_print(uint8_t *prefix, uint8_t *data, size_t len)
{
	char buf[len + 1];

	memcpy(buf, data, len);
	buf[len] = 0;
	LOG_INF("%s%s", (char *)prefix, (char *)buf);
}

/**@brief Function to publish data on the configured topic
 */
/* STEP 7.1 - Define the function data_publish() to publish data */
int data_publish(struct mqtt_client *c, enum mqtt_qos qos,
	uint8_t *data, size_t len)
{
	struct mqtt_publish_param param;

	param.message.topic.qos = qos;
	param.message.topic.topic.utf8 = CONFIG_MQTT_PUB_TOPIC;
	param.message.topic.topic.size = strlen(CONFIG_MQTT_PUB_TOPIC);
	param.message.payload.data = data;
	param.message.payload.len = len;
	param.message_id = sys_rand32_get();
	param.dup_flag = 0;
	param.retain_flag = 0;

	data_print("Publishing: ", data, len);
	LOG_INF("to topic: %s len: %u",
		CONFIG_MQTT_PUB_TOPIC,
		(unsigned int)strlen(CONFIG_MQTT_PUB_TOPIC));

	return mqtt_publish(c, &param);
}


/**@brief MQTT client event handler
 */
void mqtt_evt_handler(struct mqtt_client *const c,
		      const struct mqtt_evt *evt)
{
	int err;

	switch (evt->type) {
	case MQTT_EVT_CONNACK:
	/* STEP 5 - Subscribe to the topic CONFIG_MQTT_SUB_TOPIC when we have a successful connection */
	if (evt->result != 0) {
		LOG_ERR("MQTT connect failed: %d", evt->result);
		break;
	}
	
	LOG_INF("MQTT client connected");
	subscribe(c);
	break;

	case MQTT_EVT_DISCONNECT:
		LOG_INF("MQTT client disconnected: %d", evt->result);
		break;

	case MQTT_EVT_PUBLISH:
	/* STEP 6 - Listen to published messages received from the broker and extract the message */
	{
		/* STEP 6.1 - Extract the payload */
		const struct mqtt_publish_param *p = &evt->param.publish;
		//Print the length of the recived message 
		LOG_INF("MQTT PUBLISH result=%d len=%d", evt->result, p->message.payload.len);

		//Extract the data of the recived message 
		err = get_received_payload(c, p->message.payload.len);
				
		//Send acknowledgment to the broker on receiving QoS1 publish message 
		if (p->message.topic.qos == MQTT_QOS_1_AT_LEAST_ONCE) {
			const struct mqtt_puback_param ack = {
				.message_id = p->message_id
			};

			/* Send acknowledgment. */
			mqtt_publish_qos1_ack(c, &ack);
		}
		/* STEP 6.2 - On successful extraction of data */
		//On successful extraction of data 
		if (err >= 0) {
			data_print("Received: ", payload_buf, p->message.payload.len);
			// Control the LED 
			if (strncmp(payload_buf, CONFIG_TURN_LED_ON_CMD, sizeof(CONFIG_TURN_LED_ON_CMD) - 1) == 0) {
				dk_set_led_on(LED_CONTROL_OVER_MQTT);
			} else if (strncmp(payload_buf, CONFIG_TURN_LED_OFF_CMD, sizeof(CONFIG_TURN_LED_OFF_CMD) - 1) == 0) {
				dk_set_led_off(LED_CONTROL_OVER_MQTT);
			}
		}
		/* STEP 6.3 - On failed extraction of data */
		// On failed extraction of data - Payload buffer is smaller than the recived data . Increase 
		else if (err == -EMSGSIZE) {
			LOG_ERR("Received payload (%d bytes) is larger than the payload buffer size (%d bytes).",
				p->message.payload.len, sizeof(payload_buf));
		//On failed extraction of data - Failed to extract data, disconnect 
		} else {
			LOG_ERR("get_received_payload failed: %d", err);
			LOG_INF("Disconnecting MQTT client...");

			err = mqtt_disconnect(c);
			if (err) {
				LOG_ERR("Could not disconnect: %d", err);
			}
		}
	} break;



	case MQTT_EVT_PUBACK:
		if (evt->result != 0) {
			LOG_ERR("MQTT PUBACK error: %d", evt->result);
			break;
		}

		LOG_INF("PUBACK packet id: %u", evt->param.puback.message_id);
		break;

	case MQTT_EVT_SUBACK:
		if (evt->result != 0) {
			LOG_ERR("MQTT SUBACK error: %d", evt->result);
			break;
		}

		LOG_INF("SUBACK packet id: %u", evt->param.suback.message_id);
		break;

	case MQTT_EVT_PINGRESP:
		if (evt->result != 0) {
			LOG_ERR("MQTT PINGRESP error: %d", evt->result);
		}
		break;

	default:
		LOG_INF("Unhandled MQTT event type: %d", evt->type);
		break;
	}
}

/**@brief Resolves the configured hostname and
 * initializes the MQTT broker structure
 */
static int broker_init(void)
{
	int err;
	struct addrinfo *result;
	struct addrinfo *addr;
	struct addrinfo hints = {
		.ai_family = AF_INET,
		.ai_socktype = SOCK_STREAM
	};

	err = getaddrinfo(CONFIG_MQTT_BROKER_HOSTNAME, NULL, &hints, &result);
	if (err) {
		LOG_ERR("getaddrinfo failed: %d", err);
		return -ECHILD;
	}

	addr = result;

	/* Look for address of the broker. */
	while (addr != NULL) {
		/* IPv4 Address. */
		if (addr->ai_addrlen == sizeof(struct sockaddr_in)) {
			struct sockaddr_in *broker4 =
				((struct sockaddr_in *)&broker);
			char ipv4_addr[NET_IPV4_ADDR_LEN];

			broker4->sin_addr.s_addr =
				((struct sockaddr_in *)addr->ai_addr)
				->sin_addr.s_addr;
			broker4->sin_family = AF_INET;
			broker4->sin_port = htons(CONFIG_MQTT_BROKER_PORT);

			inet_ntop(AF_INET, &broker4->sin_addr.s_addr,
				  ipv4_addr, sizeof(ipv4_addr));
			LOG_INF("IPv4 Address found %s", (char *)(ipv4_addr));

			break;
		} else {
			LOG_ERR("ai_addrlen = %u should be %u or %u",
				(unsigned int)addr->ai_addrlen,
				(unsigned int)sizeof(struct sockaddr_in),
				(unsigned int)sizeof(struct sockaddr_in6));
		}

		addr = addr->ai_next;
	}

	/* Free the address. */
	freeaddrinfo(result);

	return err;
}

/* Function to get the client id */
static const uint8_t* client_id_get(void)
{
	static uint8_t client_id[MAX(sizeof(CONFIG_MQTT_CLIENT_ID),
				     CLIENT_ID_LEN)];

	if (strlen(CONFIG_MQTT_CLIENT_ID) > 0) {
		snprintf(client_id, sizeof(client_id), "%s",
			 CONFIG_MQTT_CLIENT_ID);
		goto exit;
	}

	char imei_buf[CGSN_RESPONSE_LENGTH + 1];
	int err;

	err = nrf_modem_at_cmd(imei_buf, sizeof(imei_buf), "AT+CGSN");
	if (err) {
		LOG_ERR("Failed to obtain IMEI, error: %d", err);
		goto exit;
	}

	imei_buf[IMEI_LEN] = '\0';

	snprintf(client_id, sizeof(client_id), "nrf-%.*s", IMEI_LEN, imei_buf);

exit:
	LOG_DBG("client_id = %s", (char *)(client_id));

	return client_id;
}


/**@brief Initialize the MQTT client structure
 */
/* STEP 3 - Define the function client_init() to initialize the MQTT client instance.  */
int client_init(struct mqtt_client *client)
{
	int err;
	/* initializes the client instance. */
	mqtt_client_init(client);

	/* Resolves the configured hostname and initializes the MQTT broker structure */
	err = broker_init();
	if (err) {
		LOG_ERR("Failed to initialize broker connection");
		return err;
	}

	/* MQTT client configuration */
	client->broker = &broker;
	client->evt_cb = mqtt_evt_handler;
	client->client_id.utf8 = client_id_get();
	client->client_id.size = strlen(client->client_id.utf8);
	client->password = NULL;
	client->user_name = NULL;
	client->protocol_version = MQTT_VERSION_3_1_1;

	/* MQTT buffers configuration */
	client->rx_buf = rx_buffer;
	client->rx_buf_size = sizeof(rx_buffer);
	client->tx_buf = tx_buffer;
	client->tx_buf_size = sizeof(tx_buffer);

	/* We are not using TLS in Exercise 1 */
	client->transport.type = MQTT_TRANSPORT_NON_SECURE;


	return err;
}

/**@brief Initialize the file descriptor structure used by poll.
 */
int fds_init(struct mqtt_client *c, struct pollfd *fds)
{
	if (c->transport.type == MQTT_TRANSPORT_NON_SECURE) {
		fds->fd = c->transport.tcp.sock;
	} else {
		return -ENOTSUP;
	}

	fds->events = POLLIN;

	return 0;
}
```
